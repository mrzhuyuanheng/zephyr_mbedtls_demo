/*
 * Copyright (c) 2012-2014 Wind River Systems, Inc.
 *
 * SPDX-License-Identifier: Apache-2.0
 */

#include <zephyr/zephyr.h>

#include "mbedtls/pk.h"
#include "mbedtls/rsa.h"
#include "mbedtls/sha256.h"
#include "mbedtls/base64.h"

// #define INPUT_TYPE_BIN
#define SIGNATURE_BASE64_ENCODE

#ifdef INPUT_TYPE_BIN

/* below two public keys can all run good, 
 * Attention: at the end must have '\0' 
 */
// 1. only have '\n', and also have '\0' at end
// const uint8_t PUBLIC_KEY[] = {0x2d,0x2d,0x2d,0x2d,0x2d,0x42,0x45,0x47,0x49,0x4e,0x20,0x50,0x55,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0xa,0x00};
// 2. have "\r\n", and also have '\0' at end
const uint8_t PUBLIC_KEY[] = {0x2d,0x2d,0x2d,0x2d,0x2d,0x42,0x45,0x47,0x49,0x4e,0x20,0x50,0x55,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0xa,0x00};

const uint8_t RAW_STRINGS[] = {0x74,0x65,0x73,0x74,0x63,0x68,0x69,0x70,0x33,0x3e,0x3e,0x61,0x62,0x31,0x3b,0x61,0x62,0x32,0x3b};

#else

/* below two public keys can all run good */

const unsigned char *PUBLIC_KEY = \
	"-----BEGIN PUBLIC KEY-----\n" \
	"MIIBIjANBgkqhkiG9w0BAQEFAAOCAQ8AMIIBCgKCAQEAs3utJqPZVtX5LgGjcGrj\n" \
	"B2L2hLnwufRtJsUhZToXMj4D9/hN2GWAD4tFqZnc7RDTHcdq+gtRvXdqR71DRA1Q\n" \
	"7phLs5gJxzk+iHyx1MEYedIcQml8knTbZ//HlSMzU0LFa4p5I2jhPt848w6uRQHM\n" \
	"7IwRb6ZzkCOxhamiO1iVodYQEJcQBNy5M4mJ3nH6REEqqLhz4JTFBk0MAAgspMQ8\n" \
	"rQ3WeuO2VF9ScjtJ3KmlDD0szY5ST2o4DIF/T9HueVdiguHUI6BFP8FnWEnXdolb\n" \
	"YFwUN8bG2BtXIV/EdWBLH6MtuLT9KjVT6wyX2xfixBkp4LX21lKvnq//Lv9+Mw9K\n" \
	"YwIDAQAB\n" \
	"-----END PUBLIC KEY-----\n";

// const unsigned char *PUBLIC_KEY = \
// 	"-----BEGIN PUBLIC KEY-----\r\n" \
// 	"MIIBIjANBgkqhkiG9w0BAQEFAAOCAQ8AMIIBCgKCAQEAs3utJqPZVtX5LgGjcGrj\r\n"	\
// 	"B2L2hLnwufRtJsUhZToXMj4D9/hN2GWAD4tFqZnc7RDTHcdq+gtRvXdqR71DRA1Q\r\n"	\
// 	"7phLs5gJxzk+iHyx1MEYedIcQml8knTbZ//HlSMzU0LFa4p5I2jhPt848w6uRQHM\r\n"	\
// 	"7IwRb6ZzkCOxhamiO1iVodYQEJcQBNy5M4mJ3nH6REEqqLhz4JTFBk0MAAgspMQ8\r\n"	\
// 	"rQ3WeuO2VF9ScjtJ3KmlDD0szY5ST2o4DIF/T9HueVdiguHUI6BFP8FnWEnXdolb\r\n"	\
// 	"YFwUN8bG2BtXIV/EdWBLH6MtuLT9KjVT6wyX2xfixBkp4LX21lKvnq//Lv9+Mw9K\r\n"	\
// 	"YwIDAQAB\r\n"	\
// 	"-----END PUBLIC KEY-----\r\n";

const uint8_t *RAW_STRINGS = "testchip3>>ab1;ab2;";

#endif

#ifdef SIGNATURE_BASE64_ENCODE
const char *SIGNED_STRING= "NwX4GHHc6njm/uwfgqwnNsbiS2PXsR9um1Bl9O++k1cRnpKiX+pods++O6ioSArlDeNpuFO6u6Gt1AGEl+Kb/hZvQOB7sDo8nQNlW8ezwF2E2Cb3QYCFz5L04Ik/f+rJo2t/N2jgHtxSbV5aH8sYqmdLkc6rn6/1+l/EU/nzSkVKh9AZ4I6HVv+u03b55nztcziF1EylzRT5QmvpCulFaWnKhPwo2c/vmH9LIeAFN1zmDutUpJeMxK68IlgA0HGrcz0ya5zEwsoPYGCfsOk7XCT+n+NISnW6py3FeKZyc6ZZ6QzFB7QajqFN7T/oEekZaT3gtCxrNNcieOSqNMvJbA==";

#else
const uint8_t SIGNED_STRING[] = {0x37,0x5,0xf8,0x18,0x71,0xdc,0xea,0x78,0xe6,0xfe,0xec,0x1f,0x82,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0xc9,0x6c};

#endif

void main(void)
{
	printk("Hello World! %s\n\n", CONFIG_BOARD);

	mbedtls_pk_context pk;
	unsigned char hash[32];
	int ret = 0;

	printk("Start RSA verify !\n\n");

	memset(hash, 0, sizeof(hash));
	mbedtls_pk_init(&pk);

#ifdef INPUT_TYPE_BIN
	printk("Parse RSA public key !\n");
	/* Attention: must include '\0' */
	ret = mbedtls_pk_parse_public_key(&pk, (const unsigned char *)PUBLIC_KEY, sizeof(PUBLIC_KEY));
	printk("parse public key ret = %d\n\n", ret);

	printk("Set RSA padding !\n");
	ret = mbedtls_rsa_set_padding(mbedtls_pk_rsa(pk), MBEDTLS_RSA_PKCS_V15, MBEDTLS_MD_SHA256);
	printk("mbedtls_rsa_set_padding ret = %d\n\n", ret);

	printk("Calculate SHA256 !\n");
	ret = mbedtls_sha256(RAW_STRINGS, sizeof(RAW_STRINGS), hash, 0);
	printk("mbedtls_sha256 ret = %d\n", ret);

	printk("Raw string: ");
	for(int i = 0; i < sizeof(RAW_STRINGS); i++){
		printk("%c", (signed char)(RAW_STRINGS[i]));
	}
	printk("\n");

#else
	printk("Parse RSA public key !\n");
	/* Attention: must include '\0' */
	ret = mbedtls_pk_parse_public_key(&pk, (const unsigned char *)PUBLIC_KEY, strlen((const char *)PUBLIC_KEY) + 1);
	printk("parse public key ret = %d\n\n", ret);

	printk("Set RSA padding !\n");
	ret = mbedtls_rsa_set_padding(mbedtls_pk_rsa(pk), MBEDTLS_RSA_PKCS_V15, MBEDTLS_MD_SHA256);
	printk("mbedtls_rsa_set_padding ret = %d\n\n", ret);

	printk("Calculate SHA256 !\n");
	/* Attention: don't use sizeof()， because calculate sha256 not include '\0' */
	ret = mbedtls_sha256(RAW_STRINGS, strlen(RAW_STRINGS), hash, 0);
	printk("mbedtls_sha256 ret = %d\n", ret);

	printk("Raw string: ");
	for(int i = 0; i < strlen(RAW_STRINGS); i++){
		printk("%c", (signed char)(RAW_STRINGS[i]));
	}
	printk("\n");

#endif

	printk("Sha256 result: ");
	for(int i = 0; i < sizeof(hash); i++){
		printk("%x", hash[i]);
	}
	printk("\n\n");

#ifdef SIGNATURE_BASE64_ENCODE
	printk("Get signature bin size len : ");
	int decoded_len = 0;
	ret = mbedtls_base64_decode(NULL, 0, &decoded_len, SIGNED_STRING, strlen(SIGNED_STRING));
	if(ret != 0 && ret != MBEDTLS_ERR_BASE64_BUFFER_TOO_SMALL){
		printk("%d\nmbedtls_base64_decode failed: %d, decoded_len: %d\n", decoded_len, ret, decoded_len);
		// return;
	}else{
		printk("%d\n", decoded_len);
	}

	unsigned char* binary_data = (unsigned char*)k_malloc(decoded_len);
	if(binary_data == NULL){
		printk("binary_data k_malloc failed\n");
		return;
	}else{
		printk("binary_data k_malloc success\n");
	}

	ret = mbedtls_base64_decode(binary_data, decoded_len, &decoded_len, SIGNED_STRING, strlen(SIGNED_STRING));
	if(ret != 0){
		printk("mbedtls_base64_decode failed: %d, decoded_len: %d\n", ret, decoded_len);
		// return;
	}else{
		printk("mbedtls_base64_decode success, decoded_len: %d\n", decoded_len);
	}

	printk("decoded result: len: %d\n", decoded_len);
	for(int i = 0; i < decoded_len; i++){
		printk("%02x ", binary_data[i]);

		if((i + 1) % 32 == 0){
			printk("\n");
		}
	}
	printk("\n\n");

	printk("Verify RSA_SHA256_PKCS_V15 signature !\n");
	ret = mbedtls_pk_verify(&pk, MBEDTLS_MD_SHA256, hash, 0, binary_data, decoded_len);
	printk("mbedtls_pk_verify ret = %d\n\n", ret);

	k_free(binary_data);

#else
	printk("Verify RSA_SHA256_PKCS_V15 signature !\n");
	ret = mbedtls_pk_verify(&pk, MBEDTLS_MD_SHA256, hash, 0, SIGNED_STRING, sizeof(SIGNED_STRING));
	printk("mbedtls_pk_verify ret = %d\n\n", ret);
#endif

	if(ret == 0){
		printk("Verify Passed\n\n");
	}else{
		printk("Verify Failed\n\n");
	}

	mbedtls_pk_free(&pk);

	return ret;
}
