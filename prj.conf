## prj.conf
```kconfig
# nothing here
CONFIG_LOG=y
CONFIG_LOG_PRINTK=y
CONFIG_LOG_MODE_IMMEDIATE=y

CONFIG_UART_INTERRUPT_DRIVEN=y
CONFIG_NEWLIB_LIBC=y
CONFIG_NEWLIB_LIBC_FLOAT_PRINTF=y
CONFIG_NEWLIB_LIBC_FLOAT_SCANF=y
CONFIG_NEWLIB_LIBC_MIN_REQUIRED_HEAP_SIZE=4096

CONFIG_MBEDTLS=y
CONFIG_MBEDTLS_BUILTIN=y

CONFIG_MBEDTLS_CFG_FILE="config-tls-generic.h"
# CONFIG_MBEDTLS_CFG_FILE="config-no-entropy.h"
CONFIG_CUSTOM_MBEDTLS_CFG_FILE=y

CONFIG_MBEDTLS_ENABLE_HEAP=y
CONFIG_MBEDTLS_HEAP_SIZE=51200

CONFIG_MBEDTLS_KEY_EXCHANGE_RSA_PSK_ENABLED=y
CONFIG_MBEDTLS_PEM_CERTIFICATE_FORMAT=y

CONFIG_MBEDTLS_DEBUG=y

CONFIG_MAIN_STACK_SIZE=8192
CONFIG_HEAP_MEM_POOL_SIZE=81920
```

## src/main.c
```c
/*
 * Copyright (c) 2012-2014 Wind River Systems, Inc.
 *
 * SPDX-License-Identifier: Apache-2.0
 */

#include <zephyr/zephyr.h>

#include "mbedtls/pk.h"
#include "mbedtls/rsa.h"
#include "mbedtls/sha256.h"
#include "mbedtls/base64.h"

// #define INPUT_TYPE_BIN
#define SIGNATURE_BASE64_ENCODE

#ifdef INPUT_TYPE_BIN

/* below two public keys can all run good, 
 * Attention: at the end must have '\0' 
 */
// 1. only have '\n', and also have '\0' at end
// const uint8_t PUBLIC_KEY[] = {0x2d,0x2d,0x2d,0x2d,0x2d,0x42,0x45,0x47,0x49,0x4e,0x20,0x50,0x55,0x42,0x4c,0x49,0x43,0x20,0x4b,0x45,0x59,0x2d,0x2d,0x2d,0x2d,0x2d,0xa,0x4d,0x49,0x49,0x42,0x49,0x6a,0x41,0x4e,0x42,0x67,0x6b,0x71,0x68,0x6b,0x69,0x47,0x39,0x77,0x30,0x42,0x41,0x51,0x45,0x46,0x41,0x41,0x4f,0x43,0x41,0x51,0x38,0x41,0x4d,0x49,0x49,0x42,0x43,0x67,0x4b,0x43,0x41,0x51,0x45,0x41,0x73,0x33,0x75,0x74,0x4a,0x71,0x50,0x5a,0x56,0x74,0x58,0x35,0x4c,0x67,0x47,0x6a,0x63,0x47,0x72,0x6a,0xa,0x42,0x32,0x4c,0x32,0x68,0x4c,0x6e,0x77,0x75,0x66,0x52,0x74,0x4a,0x73,0x55,0x68,0x5a,0x54,0x6f,0x58,0x4d,0x6a,0x34,0x44,0x39,0x2f,0x68,0x4e,0x32,0x47,0x57,0x41,0x44,0x34,0x74,0x46,0x71,0x5a,0x6e,0x63,0x37,0x52,0x44,0x54,0x48,0x63,0x64,0x71,0x2b,0x67,0x74,0x52,0x76,0x58,0x64,0x71,0x52,0x37,0x31,0x44,0x52,0x41,0x31,0x51,0xa,0x37,0x70,0x68,0x4c,0x73,0x35,0x67,0x4a,0x78,0x7a,0x6b,0x2b,0x69,0x48,0x79,0x78,0x31,0x4d,0x45,0x59,0x65,0x64,0x49,0x63,0x51,0x6d,0x6c,0x38,0x6b,0x6e,0x54,0x62,0x5a,0x2f,0x2f,0x48,0x6c,0x53,0x4d,0x7a,0x55,0x30,0x4c,0x46,0x61,0x34,0x70,0x35,0x49,0x32,0x6a,0x68,0x50,0x74,0x38,0x34,0x38,0x77,0x36,0x75,0x52,0x51,0x48,0x4d,0xa,0x37,0x49,0x77,0x52,0x62,0x36,0x5a,0x7a,0x6b,0x43,0x4f,0x78,0x68,0x61,0x6d,0x69,0x4f,0x31,0x69,0x56,0x6f,0x64,0x59,0x51,0x45,0x4a,0x63,0x51,0x42,0x4e,0x79,0x35,0x4d,0x34,0x6d,0x4a,0x33,0x6e,0x48,0x36,0x52,0x45,0x45,0x71,0x71,0x4c,0x68,0x7a,0x34,0x4a,0x54,0x46,0x42,0x6b,0x30,0x4d,0x41,0x41,0x67,0x73,0x70,0x4d,0x51,0x38,0xa,0x72,0x51,0x33,0x57,0x65,0x75,0x4f,0x32,0x56,0x46,0x39,0x53,0x63,0x6a,0x74,0x4a,0x33,0x4b,0x6d,0x6c,0x44,0x44,0x30,0x73,0x7a,0x59,0x35,0x53,0x54,0x32,0x6f,0x34,0x44,0x49,0x46,0x2f,0x54,0x39,0x48,0x75,0x65,0x56,0x64,0x69,0x67,0x75,0x48,0x55,0x49,0x36,0x42,0x46,0x50,0x38,0x46,0x6e,0x57,0x45,0x6e,0x58,0x64,0x6f,0x6c,0x62,0xa,0x59,0x46,0x77,0x55,0x4e,0x38,0x62,0x47,0x32,0x42,0x74,0x58,0x49,0x56,0x2f,0x45,0x64,0x57,0x42,0x4c,0x48,0x36,0x4d,0x74,0x75,0x4c,0x54,0x39,0x4b,0x6a,0x56,0x54,0x36,0x77,0x79,0x58,0x32,0x78,0x66,0x69,0x78,0x42,0x6b,0x70,0x34,0x4c,0x58,0x32,0x31,0x6c,0x4b,0x76,0x6e,0x71,0x2f,0x2f,0x4c,0x76,0x39,0x2b,0x4d,0x77,0x39,0x4b,0xa,0x59,0x77,0x49,0x44,0x41,0x51,0x41,0x42,0xa,0x2d,0x2d,0x2d,0x2d,0x2d,0x45,0x4e,0x44,0x20,0x50,0x55,0x42,0x4c,0x49,0x43,0x20,0x4b,0x45,0x59,0x2d,0x2d,0x2d,0x2d,0x2d,0xa,0x00};
// 2. have "\r\n", and also have '\0' at end
const uint8_t PUBLIC_KEY[] = {0x2d,0x2d,0x2d,0x2d,0x2d,0x42,0x45,0x47,0x49,0x4e,0x20,0x50,0x55,0x42,0x4c,0x49,0x43,0x20,0x4b,0x45,0x59,0x2d,0x2d,0x2d,0x2d,0x2d,0xd,0xa,0x4d,0x49,0x49,0x42,0x49,0x6a,0x41,0x4e,0x42,0x67,0x6b,0x71,0x68,0x6b,0x69,0x47,0x39,0x77,0x30,0x42,0x41,0x51,0x45,0x46,0x41,0x41,0x4f,0x43,0x41,0x51,0x38,0x41,0x4d,0x49,0x49,0x42,0x43,0x67,0x4b,0x43,0x41,0x51,0x45,0x41,0x73,0x33,0x75,0x74,0x4a,0x71,0x50,0x5a,0x56,0x74,0x58,0x35,0x4c,0x67,0x47,0x6a,0x63,0x47,0x72,0x6a,0xd,0xa,0x42,0x32,0x4c,0x32,0x68,0x4c,0x6e,0x77,0x75,0x66,0x52,0x74,0x4a,0x73,0x55,0x68,0x5a,0x54,0x6f,0x58,0x4d,0x6a,0x34,0x44,0x39,0x2f,0x68,0x4e,0x32,0x47,0x57,0x41,0x44,0x34,0x74,0x46,0x71,0x5a,0x6e,0x63,0x37,0x52,0x44,0x54,0x48,0x63,0x64,0x71,0x2b,0x67,0x74,0x52,0x76,0x58,0x64,0x71,0x52,0x37,0x31,0x44,0x52,0x41,0x31,0x51,0xd,0xa,0x37,0x70,0x68,0x4c,0x73,0x35,0x67,0x4a,0x78,0x7a,0x6b,0x2b,0x69,0x48,0x79,0x78,0x31,0x4d,0x45,0x59,0x65,0x64,0x49,0x63,0x51,0x6d,0x6c,0x38,0x6b,0x6e,0x54,0x62,0x5a,0x2f,0x2f,0x48,0x6c,0x53,0x4d,0x7a,0x55,0x30,0x4c,0x46,0x61,0x34,0x70,0x35,0x49,0x32,0x6a,0x68,0x50,0x74,0x38,0x34,0x38,0x77,0x36,0x75,0x52,0x51,0x48,0x4d,0xd,0xa,0x37,0x49,0x77,0x52,0x62,0x36,0x5a,0x7a,0x6b,0x43,0x4f,0x78,0x68,0x61,0x6d,0x69,0x4f,0x31,0x69,0x56,0x6f,0x64,0x59,0x51,0x45,0x4a,0x63,0x51,0x42,0x4e,0x79,0x35,0x4d,0x34,0x6d,0x4a,0x33,0x6e,0x48,0x36,0x52,0x45,0x45,0x71,0x71,0x4c,0x68,0x7a,0x34,0x4a,0x54,0x46,0x42,0x6b,0x30,0x4d,0x41,0x41,0x67,0x73,0x70,0x4d,0x51,0x38,0xd,0xa,0x72,0x51,0x33,0x57,0x65,0x75,0x4f,0x32,0x56,0x46,0x39,0x53,0x63,0x6a,0x74,0x4a,0x33,0x4b,0x6d,0x6c,0x44,0x44,0x30,0x73,0x7a,0x59,0x35,0x53,0x54,0x32,0x6f,0x34,0x44,0x49,0x46,0x2f,0x54,0x39,0x48,0x75,0x65,0x56,0x64,0x69,0x67,0x75,0x48,0x55,0x49,0x36,0x42,0x46,0x50,0x38,0x46,0x6e,0x57,0x45,0x6e,0x58,0x64,0x6f,0x6c,0x62,0xd,0xa,0x59,0x46,0x77,0x55,0x4e,0x38,0x62,0x47,0x32,0x42,0x74,0x58,0x49,0x56,0x2f,0x45,0x64,0x57,0x42,0x4c,0x48,0x36,0x4d,0x74,0x75,0x4c,0x54,0x39,0x4b,0x6a,0x56,0x54,0x36,0x77,0x79,0x58,0x32,0x78,0x66,0x69,0x78,0x42,0x6b,0x70,0x34,0x4c,0x58,0x32,0x31,0x6c,0x4b,0x76,0x6e,0x71,0x2f,0x2f,0x4c,0x76,0x39,0x2b,0x4d,0x77,0x39,0x4b,0xd,0xa,0x59,0x77,0x49,0x44,0x41,0x51,0x41,0x42,0xd,0xa,0x2d,0x2d,0x2d,0x2d,0x2d,0x45,0x4e,0x44,0x20,0x50,0x55,0x42,0x4c,0x49,0x43,0x20,0x4b,0x45,0x59,0x2d,0x2d,0x2d,0x2d,0x2d,0xd,0xa,0x00};

const uint8_t RAW_STRINGS[] = {0x74,0x65,0x73,0x74,0x63,0x68,0x69,0x70,0x33,0x3e,0x3e,0x61,0x62,0x31,0x3b,0x61,0x62,0x32,0x3b};

#else

/* below two public keys can all run good */

const unsigned char *PUBLIC_KEY = \
	"-----BEGIN PUBLIC KEY-----\n" \
	"MIIBIjANBgkqhkiG9w0BAQEFAAOCAQ8AMIIBCgKCAQEAs3utJqPZVtX5LgGjcGrj\n" \
	"B2L2hLnwufRtJsUhZToXMj4D9/hN2GWAD4tFqZnc7RDTHcdq+gtRvXdqR71DRA1Q\n" \
	"7phLs5gJxzk+iHyx1MEYedIcQml8knTbZ//HlSMzU0LFa4p5I2jhPt848w6uRQHM\n" \
	"7IwRb6ZzkCOxhamiO1iVodYQEJcQBNy5M4mJ3nH6REEqqLhz4JTFBk0MAAgspMQ8\n" \
	"rQ3WeuO2VF9ScjtJ3KmlDD0szY5ST2o4DIF/T9HueVdiguHUI6BFP8FnWEnXdolb\n" \
	"YFwUN8bG2BtXIV/EdWBLH6MtuLT9KjVT6wyX2xfixBkp4LX21lKvnq//Lv9+Mw9K\n" \
	"YwIDAQAB\n" \
	"-----END PUBLIC KEY-----\n";

// const unsigned char *PUBLIC_KEY = \
// 	"-----BEGIN PUBLIC KEY-----\r\n" \
// 	"MIIBIjANBgkqhkiG9w0BAQEFAAOCAQ8AMIIBCgKCAQEAs3utJqPZVtX5LgGjcGrj\r\n"	\
// 	"B2L2hLnwufRtJsUhZToXMj4D9/hN2GWAD4tFqZnc7RDTHcdq+gtRvXdqR71DRA1Q\r\n"	\
// 	"7phLs5gJxzk+iHyx1MEYedIcQml8knTbZ//HlSMzU0LFa4p5I2jhPt848w6uRQHM\r\n"	\
// 	"7IwRb6ZzkCOxhamiO1iVodYQEJcQBNy5M4mJ3nH6REEqqLhz4JTFBk0MAAgspMQ8\r\n"	\
// 	"rQ3WeuO2VF9ScjtJ3KmlDD0szY5ST2o4DIF/T9HueVdiguHUI6BFP8FnWEnXdolb\r\n"	\
// 	"YFwUN8bG2BtXIV/EdWBLH6MtuLT9KjVT6wyX2xfixBkp4LX21lKvnq//Lv9+Mw9K\r\n"	\
// 	"YwIDAQAB\r\n"	\
// 	"-----END PUBLIC KEY-----\r\n";

const uint8_t *RAW_STRINGS = "testchip3>>ab1;ab2;";

#endif

#ifdef SIGNATURE_BASE64_ENCODE
const char *SIGNED_STRING= "NwX4GHHc6njm/uwfgqwnNsbiS2PXsR9um1Bl9O++k1cRnpKiX+pods++O6ioSArlDeNpuFO6u6Gt1AGEl+Kb/hZvQOB7sDo8nQNlW8ezwF2E2Cb3QYCFz5L04Ik/f+rJo2t/N2jgHtxSbV5aH8sYqmdLkc6rn6/1+l/EU/nzSkVKh9AZ4I6HVv+u03b55nztcziF1EylzRT5QmvpCulFaWnKhPwo2c/vmH9LIeAFN1zmDutUpJeMxK68IlgA0HGrcz0ya5zEwsoPYGCfsOk7XCT+n+NISnW6py3FeKZyc6ZZ6QzFB7QajqFN7T/oEekZaT3gtCxrNNcieOSqNMvJbA==";

#else
const uint8_t SIGNED_STRING[] = {0x37,0x5,0xf8,0x18,0x71,0xdc,0xea,0x78,0xe6,0xfe,0xec,0x1f,0x82,0xac,0x27,0x36,0xc6,0xe2,0x4b,0x63,0xd7,0xb1,0x1f,0x6e,0x9b,0x50,0x65,0xf4,0xef,0xbe,0x93,0x57,0x11,0x9e,0x92,0xa2,0x5f,0xea,0x68,0x76,0xcf,0xbe,0x3b,0xa8,0xa8,0x48,0xa,0xe5,0xd,0xe3,0x69,0xb8,0x53,0xba,0xbb,0xa1,0xad,0xd4,0x1,0x84,0x97,0xe2,0x9b,0xfe,0x16,0x6f,0x40,0xe0,0x7b,0xb0,0x3a,0x3c,0x9d,0x3,0x65,0x5b,0xc7,0xb3,0xc0,0x5d,0x84,0xd8,0x26,0xf7,0x41,0x80,0x85,0xcf,0x92,0xf4,0xe0,0x89,0x3f,0x7f,0xea,0xc9,0xa3,0x6b,0x7f,0x37,0x68,0xe0,0x1e,0xdc,0x52,0x6d,0x5e,0x5a,0x1f,0xcb,0x18,0xaa,0x67,0x4b,0x91,0xce,0xab,0x9f,0xaf,0xf5,0xfa,0x5f,0xc4,0x53,0xf9,0xf3,0x4a,0x45,0x4a,0x87,0xd0,0x19,0xe0,0x8e,0x87,0x56,0xff,0xae,0xd3,0x76,0xf9,0xe6,0x7c,0xed,0x73,0x38,0x85,0xd4,0x4c,0xa5,0xcd,0x14,0xf9,0x42,0x6b,0xe9,0xa,0xe9,0x45,0x69,0x69,0xca,0x84,0xfc,0x28,0xd9,0xcf,0xef,0x98,0x7f,0x4b,0x21,0xe0,0x5,0x37,0x5c,0xe6,0xe,0xeb,0x54,0xa4,0x97,0x8c,0xc4,0xae,0xbc,0x22,0x58,0x0,0xd0,0x71,0xab,0x73,0x3d,0x32,0x6b,0x9c,0xc4,0xc2,0xca,0xf,0x60,0x60,0x9f,0xb0,0xe9,0x3b,0x5c,0x24,0xfe,0x9f,0xe3,0x48,0x4a,0x75,0xba,0xa7,0x2d,0xc5,0x78,0xa6,0x72,0x73,0xa6,0x59,0xe9,0xc,0xc5,0x7,0xb4,0x1a,0x8e,0xa1,0x4d,0xed,0x3f,0xe8,0x11,0xe9,0x19,0x69,0x3d,0xe0,0xb4,0x2c,0x6b,0x34,0xd7,0x22,0x78,0xe4,0xaa,0x34,0xcb,0xc9,0x6c};

#endif

void main(void)
{
	printk("Hello World! %s\n\n", CONFIG_BOARD);

	mbedtls_pk_context pk;
	unsigned char hash[32];
	int ret = 0;

	printk("Start RSA verify !\n\n");

	memset(hash, 0, sizeof(hash));
	mbedtls_pk_init(&pk);

#ifdef INPUT_TYPE_BIN
	printk("Parse RSA public key !\n");
	/* Attention: must include '\0' */
	ret = mbedtls_pk_parse_public_key(&pk, (const unsigned char *)PUBLIC_KEY, sizeof(PUBLIC_KEY));
	printk("parse public key ret = %d\n\n", ret);

	printk("Set RSA padding !\n");
	ret = mbedtls_rsa_set_padding(mbedtls_pk_rsa(pk), MBEDTLS_RSA_PKCS_V15, MBEDTLS_MD_SHA256);
	printk("mbedtls_rsa_set_padding ret = %d\n\n", ret);

	printk("Calculate SHA256 !\n");
	ret = mbedtls_sha256(RAW_STRINGS, sizeof(RAW_STRINGS), hash, 0);
	printk("mbedtls_sha256 ret = %d\n", ret);

	printk("Raw string: ");
	for(int i = 0; i < sizeof(RAW_STRINGS); i++){
		printk("%c", (signed char)(RAW_STRINGS[i]));
	}
	printk("\n");

#else
	printk("Parse RSA public key !\n");
	/* Attention: must include '\0' */
	ret = mbedtls_pk_parse_public_key(&pk, (const unsigned char *)PUBLIC_KEY, strlen((const char *)PUBLIC_KEY) + 1);
	printk("parse public key ret = %d\n\n", ret);

	printk("Set RSA padding !\n");
	ret = mbedtls_rsa_set_padding(mbedtls_pk_rsa(pk), MBEDTLS_RSA_PKCS_V15, MBEDTLS_MD_SHA256);
	printk("mbedtls_rsa_set_padding ret = %d\n\n", ret);

	printk("Calculate SHA256 !\n");
	/* Attention: don't use sizeof()， because calculate sha256 not include '\0' */
	ret = mbedtls_sha256(RAW_STRINGS, strlen(RAW_STRINGS), hash, 0);
	printk("mbedtls_sha256 ret = %d\n", ret);

	printk("Raw string: ");
	for(int i = 0; i < strlen(RAW_STRINGS); i++){
		printk("%c", (signed char)(RAW_STRINGS[i]));
	}
	printk("\n");

#endif

	printk("Sha256 result: ");
	for(int i = 0; i < sizeof(hash); i++){
		printk("%x", hash[i]);
	}
	printk("\n\n");

#ifdef SIGNATURE_BASE64_ENCODE
	printk("Get signature bin size len : ");
	int decoded_len = 0;
	ret = mbedtls_base64_decode(NULL, 0, &decoded_len, SIGNED_STRING, strlen(SIGNED_STRING));
	if(ret != 0 && ret != MBEDTLS_ERR_BASE64_BUFFER_TOO_SMALL){
		printk("%d\nmbedtls_base64_decode failed: %d, decoded_len: %d\n", decoded_len, ret, decoded_len);
		// return;
	}else{
		printk("%d\n", decoded_len);
	}

	unsigned char* binary_data = (unsigned char*)k_malloc(decoded_len);
	if(binary_data == NULL){
		printk("binary_data k_malloc failed\n");
		return;
	}else{
		printk("binary_data k_malloc success\n");
	}

	ret = mbedtls_base64_decode(binary_data, decoded_len, &decoded_len, SIGNED_STRING, strlen(SIGNED_STRING));
	if(ret != 0){
		printk("mbedtls_base64_decode failed: %d, decoded_len: %d\n", ret, decoded_len);
		// return;
	}else{
		printk("mbedtls_base64_decode success, decoded_len: %d\n", decoded_len);
	}

	printk("decoded result: len: %d\n", decoded_len);
	for(int i = 0; i < decoded_len; i++){
		printk("%02x ", binary_data[i]);

		if((i + 1) % 32 == 0){
			printk("\n");
		}
	}
	printk("\n\n");

	printk("Verify RSA_SHA256_PKCS_V15 signature !\n");
	ret = mbedtls_pk_verify(&pk, MBEDTLS_MD_SHA256, hash, 0, binary_data, decoded_len);
	printk("mbedtls_pk_verify ret = %d\n\n", ret);

	k_free(binary_data);

#else
	printk("Verify RSA_SHA256_PKCS_V15 signature !\n");
	ret = mbedtls_pk_verify(&pk, MBEDTLS_MD_SHA256, hash, 0, SIGNED_STRING, sizeof(SIGNED_STRING));
	printk("mbedtls_pk_verify ret = %d\n\n", ret);
#endif

	if(ret == 0){
		printk("Verify Passed\n\n");
	}else{
		printk("Verify Failed\n\n");
	}

	mbedtls_pk_free(&pk);

	return ret;
}
```
